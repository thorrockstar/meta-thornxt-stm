## conf/distro/thor-stm.conf
```bitbake
DISTRO = "thor-stm"
DISTRO_NAME = "Thor (Yocto Project Thor Distro)"
DISTRO_VERSION = "5.0.16"
DISTRO_CODENAME = "scarthgap"
SDK_VENDOR = "-thorsdk"
SDK_VERSION = "${@d.getVar('DISTRO_VERSION').replace('snapshot-${METADATA_REVISION}', 'snapshot')}"
SDK_VERSION[vardepvalue] = "${SDK_VERSION}"

MAINTAINER = "Thor <roy@thor.engineering>"

TARGET_VENDOR = "-thor"

LOCALCONF_VERSION = "2"

# Override these in poky based distros
POKY_DEFAULT_DISTRO_FEATURES = "multiarch"
POKY_DEFAULT_EXTRA_RDEPENDS = "packagegroup-core-boot"
POKY_DEFAULT_EXTRA_RRECOMMENDS = "kernel-module-af-packet"

DISTRO_FEATURES ?= "${DISTRO_FEATURES_DEFAULT} ${POKY_DEFAULT_DISTRO_FEATURES}"

PREFERRED_VERSION_linux-yocto ?= "6.6%"
PREFERRED_VERSION_linux-yocto-rt ?= "6.6%"

SDK_NAME = "${DISTRO}-${TCLIBC}-${SDKMACHINE}-${IMAGE_BASENAME}-${TUNE_PKGARCH}-${MACHINE}"
SDKPATHINSTALL = "/opt/${DISTRO}/${SDK_VERSION}"

DISTRO_EXTRA_RDEPENDS += "${POKY_DEFAULT_EXTRA_RDEPENDS}"
DISTRO_EXTRA_RRECOMMENDS += "${POKY_DEFAULT_EXTRA_RRECOMMENDS}"

TCLIBCAPPEND = ""

PACKAGE_CLASSES ?= "package_rpm"

SANITY_TESTED_DISTROS ?= " \
            poky-4.3 \n \
            poky-5.0 \n \
            ubuntu-20.04 \n \
            ubuntu-22.04 \n \
            ubuntu-23.04 \n \
            ubuntu-24.04 \n \
            fedora-38 \n \
            fedora-39 \n \
            fedora-40 \n \
            fedora-41 \n \
            centosstream-8 \n \
            debian-11 \n \
            debian-12 \n \
            opensuseleap-15.4 \n \
            almalinux-8.8 \n \
            almalinux-8.9 \n \
            almalinux-8.10 \n \
            almalinux-9.2 \n \
            almalinux-9.4 \n \
            rocky-8 \n \
            rocky-9 \n \
            "
# add poky sanity bbclass
INHERIT += "poky-sanity"

# QA check settings - a little stricter than the OE-Core defaults
# (none currently necessary as we now match OE-Core)
#WARN_TO_ERROR_QA = "X"
#WARN_QA:remove = "${WARN_TO_ERROR_QA}"
#ERROR_QA:append = " ${WARN_TO_ERROR_QA}"

CFLAGS += "-Wno-unused-result"
CXXFLAGS += "-Wno-unused-result"

require conf/distro/include/no-static-libs.inc
require conf/distro/include/yocto-uninative.inc
require conf/distro/include/security_flags.inc

INHERIT += "uninative"

BB_SIGNATURE_HANDLER ?= "OEEquivHash"
BB_HASHSERVE ??= "auto"

POKY_INIT_MANAGER = "sysvinit"
INIT_MANAGER ?= "${POKY_INIT_MANAGER}"

# We need debug symbols so that SPDX license manifests for the kernel work
KERNEL_EXTRA_FEATURES:append = " features/debug/debug-kernel.scc"

# Enable creation of SPDX manifests by default
INHERIT += "create-spdx"

# Make sure unwanted features are =-->REMOVED<--= from the distro!
DISTRO_FEATURES:remove ?= "opengl wayland vulkan x11 3g nfc pulseaudio zeroconf ofono bluetooth"

DISTRO_FEATURES += "pam ppp"

# icu is needed to get egt
PACKAGECONFIG_DISTRO:pn-egt ?= "icu openssl freetype fontconfig"

EXTRA_OECONF:remove = "${DISABLE_STATIC}"
PREFERRED_VERSION_swig = "3.0.8"

VIRTUAL-RUNTIME_syslog = "busybox-syslog"

HOSTTOOLS:append = " xxd"

# Remove RNG based on CPU timing jitter
PACKAGECONFIG:remove:pn-rng-tools = "libjitterentropy"

# Remove any ST demos.
PACKAGE_INSTALL:remove = "packagegroup-st-demo"

# Set the timestamp to a specific epoch time for reproducible builds in the rootfs.
export SOURCE_DATE_EPOCH = "1777013042"
REPRODUCIBLE_TIMESTAMP_ROOTFS = "1777013042"
```

## conf/layer.conf
```bitbake
# We have a conf and classes directory, add to BBPATH
BBPATH .= ":${LAYERDIR}"

# We have recipes-* directories, add to BBFILES
BBFILES += "${LAYERDIR}/recipes-*/*.bb \
	    ${LAYERDIR}/recipes-*/*/*.bbappend"

# NOTE
# we set priority higher than the STM layer
BBFILE_COLLECTIONS += "thornxt"
BBFILE_PATTERN_thornxt = "^${LAYERDIR}/"
BBFILE_PRIORITY_thornxt = "10"

LAYERSERIES_COMPAT_thornxt = "scarthgap"
LAYERVERSION_thornxt = "1"

# Remove unwanted features from the ST layer.
MACHINE_FEATURES:remove = "bluetooth wifi fw-update"
DISTRO_FEATURES:remove = "zeroconf ofono bluetooth 3g nfc"

# Remove unwanted dependencies from the ST layer.
LAYERDEPENDS_st-openstlinux:remove = "webserver gnome-layer multimedia-layer"

# Mask out unwanted recipes folders.
BBMASK += "/meta-st-openstlinux/recipes-multimedia/gstreamer/"
BBMASK += "/meta-st-openstlinux/recipes-webadmin/"
BBMASK += "/meta-st-openstlinux/recipes-samples/"
BBMASK += "/meta-st-openstlinux/oe-core/recipes-gnome/"
BBMASK += "/meta-st-openstlinux/oe-core/recipes-core/systemd/"

# Mask out unwanted recipes files.
BBMASK += "meta-st-openstlinux/recipes-multimedia/libcamera/libcamera-stm32mp_%.bb"

EULA_FILE_ST:stm32mpcommon = "${LAYERDIR}/conf/eula/${MACHINE}"
EULA_FILE_ST_MD5SUM:stm32mpcommon = "CAB068EAC2EC7EFE0FE07A3260C0194B"

# OpenSTLinux compatibility version
#ST_OSTL_COMPATIBILITY_VERSION_thornxt = "6.2"
```
