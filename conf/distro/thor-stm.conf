## conf/machine/stm32mp1-thor-e2.conf
```bitbake
#@TYPE: Machine
#@NAME: stm32mp1-thor-e2
#@DESCRIPTION: Configuration for THOR E2 and Nous-X boards
#@NEEDED_BSPLAYERS: layers/meta-openembedded/meta-oe layers/meta-openembedded/meta-python

# Define specific familly common machine name
MACHINEOVERRIDES =. "stm32mp1common:stm32mp15common:"

include conf/machine/include/thor-e2-machine-common-stm32mp.inc
include conf/machine/include/st-machine-providers-stm32mp.inc

# =========================================================================
# Chip architecture
# =========================================================================
DEFAULTTUNE = "cortexa7thf-neon-vfpv4"
include conf/machine/include/arm/armv7a/tune-cortexa7.inc

# =========================================================================
# boot scheme
# =========================================================================
BOOTSCHEME_LABELS += "opteemin"

# =========================================================================
# boot device
# =========================================================================
# Define the boot device supported
BOOTDEVICE_LABELS += "nand-4-256-1024"

# =========================================================================
# Machine settings
# =========================================================================
# Define list of devicetree per supported storage
STM32MP_DT_FILES_NAND += "stm32mp157x-thor stm32mp157x-nous"

# =========================================================================
# Machine features
# =========================================================================
MACHINE_FEATURES += "splashscreen"
MACHINE_FEATURES += "watchdog"
MACHINE_FEATURES += "${@'gpu' if d.getVar('ACCEPT_EULA_'+d.getVar('MACHINE')) == '1' else ''}"
MACHINE_FEATURES += "m4copro"

MACHINE_FEATURES:remove = "fw-update"

# =========================================================================
# Kernel
# =========================================================================
# Define the devicetree for Linux A7 examples
# LINUX_A7_EXAMPLES_DT += "stm32mp157f-dk2-a7-examples"

# =========================================================================
# M4 copro
# =========================================================================
# Define the devicetree for M4 example
CUBE_M4_EXAMPLES_DT += "stm32mp157f-dk2-m4-examples"

# Define specific board reference to use
# For M4 BOARD config, STM32MP157C are similar to STM32MP157F
M4_BOARDS = "STM32MP157C-DK2"

# =========================================================================
# OPTEE
# =========================================================================
# For sdk generation, declare the default board configuration to use.
ST_OPTEE_EXPORT_TA_REF_BOARD:stm32mp1common = "stm32mp157x-thor.dts"

# =========================================================================
# Signing of TF-A/FIP using THOR's private key
# =========================================================================
# Activate the signing of TF-A/FIP
# SIGN_ENABLE = "1"

# Give the absolute path to the STM32 Signing tool. For example "/home/ivan/STMicroelectronics/STM32Cube/STM32CubeProgrammer/bin/STM32_SigningTool_CLI"
# SIGN_TOOL = "your absolute path to STM32_SigningTool_CLI"

# Version for STMP32MP15X
# SIGN_HEADER_VERSION_stm32mp15 = "1.0"

# Path to the private key (PEM-Format)
# SIGN_KEY = "${THOR_LAYER_CUSTOM_PATH}/conf/machine/signing/privateKey.pem"

# Path to the public key (PEM-Format)
# SIGN_KEY_PUB_stm32mp15 = "${THOR_LAYER_CUSTOM_PATH}/conf/machine/signing/publicKey.pem"

# Password for the private key
# SIGN_KEY_PASS = "enter your password here"
```
